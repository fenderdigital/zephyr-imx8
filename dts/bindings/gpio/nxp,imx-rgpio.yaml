## dts/bindings/gpio/nxp,imx-rgpio.yaml
```yaml
# Copyright 2024 NXP
# SPDX-License-Identifier: Apache-2.0

description: i.MX RGPIO

compatible: "nxp,imx-rgpio"

include: [gpio-controller.yaml, base.yaml, "nxp,rdc-policy.yaml"]

properties:
  reg:
    required: true

  pinmux:
    type: phandles
    description: |
      IMX pin selection peripheral does not follow specific
      pattern for which GPIO port uses which pinmux. Use this property to specify
      pinctrl nodes to use for the gpio port when CONFIG_PINCTRL=y. Note that
      the order of the nodes matters. The first node for gpio1 will be used
      as the pinmux for gpio0, port 0.

  nxp,irq-sel:
    type: int
    default: 0
    description: |
      RGPIO interrupt channel selection (IRQS field in ICR registers).
      Channel 0 uses ISFR[0] and the first interrupt in the interrupts
      property. Channel 1 uses ISFR[1] and the second interrupt.
      Defaults to 0.

  "#gpio-cells":
    const: 2

gpio-cells:
  - pin
  - flags
```
