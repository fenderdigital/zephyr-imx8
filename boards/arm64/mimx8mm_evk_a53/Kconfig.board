## boards/arm64/mimx8mm_evk_a53/Kconfig.board
```kconfig
#
# Copyright 2022 NXP
#
# SPDX-License-Identifier: Apache-2.0

config BOARD_MIMX8MM_EVK_A53
	bool "NXP i.MX8M Mini A53 core EVK board"
	depends on SOC_MIMX8MM_A53
	select SOC_PART_NUMBER_MIMX8MM6DVTLZ
```

## boards/arm64/mimx8mm_evk_a53/Kconfig.defconfig
```kconfig
#
# Copyright 2022 NXP
#
# SPDX-License-Identifier: Apache-2.0

config BOARD
	default "mimx8mm_evk_a53"
	depends on BOARD_MIMX8MM_EVK_A53
```

## boards/arm64/mimx8mn_evk_a53/Kconfig.board
```kconfig
#
# Copyright 2022 NXP
#
# SPDX-License-Identifier: Apache-2.0

config BOARD_MIMX8MN_EVK_A53
	bool "NXP i.MX8M Nano A53 core EVK board"
	depends on SOC_MIMX8MN_A53
	select SOC_PART_NUMBER_MIMX8MN6DVTJZ
```

## boards/arm64/mimx8mn_evk_a53/Kconfig.defconfig
```kconfig
#
# Copyright 2022 NXP
#
# SPDX-License-Identifier: Apache-2.0

config BOARD
	default "mimx8mn_evk_a53"
	depends on BOARD_MIMX8MN_EVK_A53
```

## boards/arm64/mimx8mp_evk_a53/Kconfig.board
```kconfig
#
# Copyright 2022 NXP
#
# SPDX-License-Identifier: Apache-2.0

config BOARD_MIMX8MP_EVK_A53
	bool "NXP i.MX8M Plus A53 core EVK board"
	depends on SOC_MIMX8MP_A53
	select SOC_PART_NUMBER_MIMX8ML8DVNLZ
```

## boards/arm64/mimx8mp_evk_a53/Kconfig.defconfig
```kconfig
#
# Copyright 2022 NXP
#
# SPDX-License-Identifier: Apache-2.0

config BOARD
	default "mimx8mp_evk_a53"
	depends on BOARD_MIMX8MP_EVK_A53
```

## boards/arm64/mimx8mp_evk_a53/mimx8mp_evk_a53_defconfig
```kconfig
# SPDX-License-Identifier: Apache-2.0

# ARM Options
CONFIG_AARCH64_IMAGE_HEADER=y
CONFIG_ARMV8_A_NS=y
CONFIG_ARM64_VA_BITS_40=y
CONFIG_ARM64_PA_BITS_40=y

# Cache Options
CONFIG_CACHE_MANAGEMENT=y
CONFIG_DCACHE_LINE_SIZE_DETECT=y
CONFIG_ICACHE_LINE_SIZE_DETECT=y

# Platform Configuration
CONFIG_SOC_SERIES_IMX8MP_A53=y
CONFIG_SOC_MIMX8MP_A53=y
CONFIG_BOARD_MIMX8MP_EVK_A53=y

# Zephyr Kernel Configuration
CONFIG_SRAM_BASE_ADDRESS=0xc0000000
# 1M RAM by default
CONFIG_SRAM_SIZE=1024
CONFIG_XIP=n

# Serial Drivers
CONFIG_SERIAL=y
CONFIG_UART_INTERRUPT_DRIVEN=y

# Enable Console
CONFIG_CONSOLE=y
CONFIG_UART_CONSOLE=y

CONFIG_CLOCK_CONTROL=y
```

## drivers/dma/Kconfig.mcux_sdma
```kconfig
# DMA configuration options

# Copyright (c) 2020, NXP
# SPDX-License-Identifier: Apache-2.0

config DMA_MCUX_SDMA
	bool "Enable MCUX SDMA driver"
	depends on HAS_MCUX_SDMA
	imply NOCACHE_MEMORY if HAS_MCUX_CACHE
	help
	  DMA driver for MCUX series SoCs.

if DMA_MCUX_SDMA

endif # DMA_MCUX_EDMA
```

## dts/bindings/serial/nxp,imx-iuart.yaml
```yaml
description: |
    This binding gives a base representation of the NXP iMX IUART

compatible: "nxp,imx-iuart"

include: [uart-controller.yaml, pinctrl-device.yaml]

properties:
    reg:
      required: true

    interrupts:
      required: false

    clocks:
      required: true

    pinctrl-0:
      required: false

    pinctrl-names:
      required: false
```

## soc/arm64/nxp_imx/Kconfig
```kconfig
# Copyright 2022 NXP
# SPDX-License-Identifier: Apache-2.0

config SOC_FAMILY_IMX
	bool
	select HAS_SEGGER_RTT

if SOC_FAMILY_IMX

config SOC_FAMILY
	string
	default "nxp_imx"

source "soc/arm64/nxp_imx/*/Kconfig.soc"

config SOC_PART_NUMBER
	default SOC_PART_NUMBER_IMX8MP_A53 if SOC_SERIES_IMX8MP_A53

endif # SOC_FAMILY_IMX
```

## soc/arm64/nxp_imx/Kconfig.defconfig
```kconfig
# Copyright 2022 NXP
# SPDX-License-Identifier: Apache-2.0

source "soc/arm64/nxp_imx/*/Kconfig.defconfig.series"
```

## soc/arm64/nxp_imx/mimx8mm/Kconfig.defconfig.series
```kconfig
#
# Copyright 2022 NXP
#
# SPDX-License-Identifier: Apache-2.0
#

if SOC_SERIES_IMX8MM_A53

config SOC_SERIES
	default "mimx8mm"

config NUM_IRQS
	int
	# must be >= the highest interrupt number used
	default 159

source "soc/arm64/nxp_imx/mimx8mm/Kconfig.defconfig.mimx8mm_a53"

endif # SOC_SERIES_IMX8MM_A53
```

## soc/arm64/nxp_imx/mimx8mm/Kconfig.soc
```kconfig
#
# Copyright 2022 NXP
#
# SPDX-License-Identifier: Apache-2.0
#

choice
prompt "i.MX8M Mini SoC"
depends on SOC_SERIES_IMX8MM_A53

config SOC_MIMX8MM_A53
	bool "NXP i.MX8M Mini A53 core SoC"
	select ARM64
	select CPU_CORTEX_A53
	select ARM_ARCH_TIMER
	select GIC_V3
	select HAS_MCUX
	select HAS_MCUX_CCM
endchoice

if SOC_SERIES_IMX8MM_A53

config SOC_PART_NUMBER_MIMX8MM6DVTLZ
	bool

config SOC_PART_NUMBER_MIMX8MM6CVTKZ
	bool

config SOC_PART_NUMBER_IMX8MM_A53
	string
	default "MIMX8MM6DVTLZ_ca53" if  SOC_PART_NUMBER_MIMX8MM6DVTLZ
	default "MIMX8MM6CVTKZ_ca53" if  SOC_PART_NUMBER_MIMX8MM6CVTKZ
	help
	  This string holds the full part number of the SoC. It is a hidden option
	  that you should not set directly. The part number selection choice defines
	  the default value for this string.

endif # SOC_SERIES_IMX8MM_A53
```

## soc/arm64/nxp_imx/mimx8mn/Kconfig.defconfig.series
```kconfig
#
# Copyright 2022 NXP
#
# SPDX-License-Identifier: Apache-2.0
#

if SOC_SERIES_IMX8MN_A53

config SOC_SERIES
	default "mimx8mn"

config NUM_IRQS
	int
	# must be >= the highest interrupt number used
	default 159

source "soc/arm64/nxp_imx/mimx8mn/Kconfig.defconfig.mimx8mn_a53"

endif # SOC_SERIES_IMX8MN_A53
```

## soc/arm64/nxp_imx/mimx8mn/Kconfig.series
```kconfig
#
# Copyright 2022 NXP
#
# SPDX-License-Identifier: Apache-2.0
#

config SOC_SERIES_IMX8MN_A53
	bool "i.MX8M Nano Series (Cortex-A Cores)"
	select ARM64
	select SOC_FAMILY_IMX
	select HAS_MCUX_GPT
	help
	  Enable support for Cortex-A Cores on i.MX8M Nano series
```

## soc/arm64/nxp_imx/mimx8mn/Kconfig.soc
```kconfig
#
# Copyright 2022 NXP
#
# SPDX-License-Identifier: Apache-2.0
#

choice
prompt "i.MX8M Nano SoC"
depends on SOC_SERIES_IMX8MN_A53

config SOC_MIMX8MN_A53
	bool "NXP i.MX8M Nano A53 core SoC"
	select ARM64
	select CPU_CORTEX_A53
	select ARM_ARCH_TIMER
	select GIC_V3
	select HAS_MCUX
	select HAS_MCUX_CCM
endchoice

if SOC_SERIES_IMX8MN_A53

config SOC_PART_NUMBER_MIMX8MN6DVTJZ
	bool

config SOC_PART_NUMBER_MIMX8MN6DUCJZ
	bool

config SOC_PART_NUMBER_MIMX8MN6CVTIZ
	bool

config SOC_PART_NUMBER_MIMX8MN6CUCIZ
	bool

config SOC_PART_NUMBER_IMX8MN_A53
	string
	default "MIMX8MN6DVTJZ_ca53" if  SOC_PART_NUMBER_MIMX8MN6DVTJZ
	default "MIMX8MN6DUCJZ_ca53" if  SOC_PART_NUMBER_MIMX8MN6DUCJZ
	default "MIMX8MN6CVTIZ_ca53" if  SOC_PART_NUMBER_MIMX8MN6CVTIZ
	default "MIMX8MN6CUCIZ_ca53" if  SOC_PART_NUMBER_MIMX8MN6CUCIZ
	help
	  This string holds the full part number of the SoC. It is a hidden option
	  that you should not set directly. The part number selection choice defines
	  the default value for this string.

endif # SOC_SERIES_IMX8MN_A53
```

## soc/arm64/nxp_imx/mimx8mp/Kconfig.defconfig.mimx8mp_a53
```kconfig
#
# Copyright 2022 NXP
#
# SPDX-License-Identifier: Apache-2.0
#

if SOC_MIMX8MP_A53

config SOC
	string
	default "mimx8ml8"

config SYS_CLOCK_HW_CYCLES_PER_SEC
	int
	default 8000000

config FLASH_SIZE
	default 0

config FLASH_BASE_ADDRESS
	default 0

if CLOCK_CONTROL
config CLOCK_CONTROL_MCUX_CCM
	default y if HAS_MCUX_CCM
endif # CLOCK_CONTROL

if PINMUX
config PINMUX_MCUX
	default y
endif # PINMUX

if SERIAL
config UART_MCUX_IUART
	default y
endif # SERIAL

endif # SOC_MIMX8MP_A53
```

## soc/arm64/nxp_imx/mimx8mp/Kconfig.defconfig.series
```kconfig
#
# Copyright 2022 NXP
#
# SPDX-License-Identifier: Apache-2.0
#

if SOC_SERIES_IMX8MP_A53

config SOC_SERIES
	default "mimx8mp"

config NUM_IRQS
	int
	# must be >= the highest interrupt number used
	default 191

source "soc/arm64/nxp_imx/mimx8mp/Kconfig.defconfig.mimx8mp_a53"

endif # SOC_SERIES_IMX8MP_A53
```

## soc/arm64/nxp_imx/mimx8mp/Kconfig.soc
```kconfig
#
# Copyright 2022 NXP
#
# SPDX-License-Identifier: Apache-2.0
#

choice
prompt "i.MX8M Plus SoC"
depends on SOC_SERIES_IMX8MP_A53

config SOC_MIMX8MP_A53
	bool "NXP i.MX8M Plus A53 core SoC"
	select ARM64
	select CPU_CORTEX_A53
	select ARM_ARCH_TIMER
	select GIC_V3
	select HAS_MCUX
	select HAS_MCUX_CCM
endchoice

if SOC_SERIES_IMX8MP_A53

config SOC_PART_NUMBER_MIMX8ML8DVNLZ
	bool

config SOC_PART_NUMBER_IMX8MP_A53
	string
	default "MIMX8ML8DVNLZ_ca53" if  SOC_PART_NUMBER_MIMX8ML8DVNLZ
	help
	  This string holds the full part number of the SoC. It is a hidden option
	  that you should not set directly. The part number selection choice defines
	  the default value for this string.

endif # SOC_SERIES_IMX8MP_A53
```
